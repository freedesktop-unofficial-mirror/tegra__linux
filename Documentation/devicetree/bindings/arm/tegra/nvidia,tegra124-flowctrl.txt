## Documentation/devicetree/bindings/arm/tegra/nvidia,tegra124-flowctrl.txt
```
NVIDIA Tegra124 Flow Controller

Required properties:
- compatible: "nvidia,tegra124-flowctrl"
- reg: Should contain one register range (address and length)

Example:

	flow-controller@0,60007000 {
		compatible = "nvidia,tegra124-flowctrl";
		reg = <0x0 0x60007000 0x0 0x1000>;
	};
```
